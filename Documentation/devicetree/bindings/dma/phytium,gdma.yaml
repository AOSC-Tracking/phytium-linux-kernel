## Documentation/devicetree/bindings/dma/phytium,gdma.yaml
```yaml
# SPDX-License-Identifier: (GPL-2.0-only OR BSD-2-Clause)
%YAML 1.2
---
title: Phytium GDMA Controller bindings

description:
  The Phytium GDMA is a general-purpose direct memory access
  controller capable of supporting 16 independent DMA channels.
  DMA clients connected to the GDMA controller must use the format
  described in the dma-common.yaml file, using a one cell specifier for
  each channel, just provide the channel id to use.

maintainers:
  - Huang Jie <huangjie1663@phytium.com.cn>

allOf:
  - $ref: "dma-controller.yaml#"

properties:
  "#dma-cells":
    const: 1

  compatible:
    const: phytium,gdma

  reg:
    maxItems: 1

  interrupts:
    maxItems: 1

required:
  - compatible
  - reg
  - interrupts

unevaluatedProperties: false

examples:
		gdma: gdma@32b34000 {
			compatible = "phytium,gdma";
			reg = <0x0 0x32b34000 0x0 0x1000>;
			interrupts = <GIC_SPI 234 IRQ_TYPE_LEVEL_HIGH>;
			#dma-cells = <1>;
		};
...
```

## Documentation/devicetree/bindings/mmc/phytium-mci.txt
```
* Phytium Multimedia Card Interface controller

The highspeed MMC host controller on Phytium SoCs provides an interface
for MMC, SD and SDIO types of memory cards.

Required properties:
- compatible : should be "phytium,mci".
- reg: mmc controller base registers.
- clocks : phandles to input clocks.
- clock-names : should be "phytium_mci_clk".
- interrupts : mmc controller interrupt.
- use-hold : enable hold registers.
- clk-set : enable clock phase setiing.
- clk-smpl-drv-25m : 25M clock phase setiing.
- clk-smpl-drv-50m : 50M clock phase setiing.
- clk-smpl-drv-66m : 66M clock phase setiing.
- clk-smpl-drv-100m : 100M clock phase setiing.

Examples:
	- Within .dtsi:
	mmc0: mmc@28000000 {
		compatible = "phytium,mci";
		reg = <0x0 0x28000000 0x0 0x1000>;
		interrupts = <GIC_SPI 72 IRQ_TYPE_LEVEL_HIGH>;
		clocks = <&sysclk_1200mhz>;
		clock-names = "phytium_mci_clk";
		status = "disabled";
	};

	- Within dts:
	&mmc0 {
		bus-width = <4>;
		max-frequency = <50000000>;
		cap-sdio-irq;
		cap-sd-highspeed;
		sd-uhs-sdr12;
		sd-uhs-sdr25;
		sd-uhs-sdr50;
		no-mmc;
		use-hold;
		clk-set;
		clk-smpl-drv-50m = <0x0201>;
		status = "ok";
	};
```

## Documentation/devicetree/bindings/pci/phytium,phytium-pcie-ep.txt
```
* Phytium PCIe endpoint controller

Required properties:
- compatible: Should contain "phytium,pcie-ep-1.0" or
  "phytium,pcie-ep-2.0"
- reg: Should contain the controller register base address, AXI interface
  region base address and hpb register base address respectively.
- reg-names: Must be "reg", "mem" and "hpb" respectively.
- max-outbound-regions: Set to maximum number of outbound regions.
- max-functions: Maximum number of functions that can be configured (default 1).

Example:

ep0: ep@0x29030000 {
	compatible = "phytium,pcie-ep-1.0";
	reg = <0x0 0x29030000 0x0 0x10000>,
	      <0x11 0x00000000 0x1 0x00000000>,
	      <0x0 0x29101000 0x0 0x1000>;
	reg-names = "reg", "mem", "hpb";
	max-outbound-regions = <3>;
	max-functions = /bits/ 8 <1>;
};
```

## drivers/gpu/drm/mwv207/Kconfig
```kconfig
config DRM_MWV207
	tristate "MWV207 chip"
	depends on DRM
	select DRM_KMS_HELPER
	select SND_PCM
	select DRM_VRAM_HELPER
	select DRM_SCHED
	select DRM_TTM
	select DRM_TTM_HELPER
	help
	  Choose this option if you have a Jingjia graphics card. 
          If M is selected, the module will be called mwv207 (JM9100).
```
