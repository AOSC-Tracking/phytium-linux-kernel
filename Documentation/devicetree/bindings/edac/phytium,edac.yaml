## Documentation/devicetree/bindings/edac/phytium,edac.yaml
```yaml
# SPDX-License-Identifier: GPL-2.0-only OR BSD-2-Clause
%YAML 1.2
---
$id: http://devicetree.org/schemas/edac/phytium,edac.yaml#
$schema: http://devicetree.org/meta-schemas/core.yaml#

title: Phytium SoC EDAC node

maintainers:
  - Huang Jie <huangjie1663@phytium.com.cn>
  - Chen Baozi <chenbaozi@phytium.com.cn>

description: |
  This binding describes the EDAC (Error Detection and Correction) controller
  found in Phytium SoC families, The EDAC unit is responsible for monitoring and
  reporting errors from various system components, including the memory
  controller.

properties:

  compatible:
    oneOf:
      - description: For Phytium PE220x series SoCs
        items:
          - const: phytium,pe220x-edac

      - description: For Phytium PD2008 series SoCs
        items:
          - const: phytium,pd2008-edac

      - description: For Phytium PD2208 series SoCs
        items:
          - const: phytium,pd2208-edac

      - description: For Phytium PD1904 series SoCs
        items:
          - const: phytium,pd1904-edac

  reg:
    description:
      A list of memory regions for the RAS register sets.
    maxItems: 3

  interrupts:
    description:
      The interrupt lines from RAS.
    maxItems: 3

  ranges:
    type: boolean

  "#address-cells":
    const: 2

  "#size-cells":
    const: 2

patternProperties:
  "memory-controller":
    type: object
    description:
      Represents a memory controller instance that is managed by the main EDAC
      controller.

    properties:
      compatible:
        const: phytium,edac-mc

      reg:
        maxItems: 1
        description: Register region for this memory controller.

      memory-controller:
        description: The ID of this memory controller.

    required:
      - compatible
      - reg
      - memory-controller

    additionalProperties: false

required:
  - compatible
  - reg
  - interrupts
  - "#address-cells"
  - "#size-cells"

additionalProperties: false

examples:
  - |
    edac: edac@32b28000 {
      compatible = "phytium,pe220x-edac";
      ranges;
      reg = <0x0 0x32b28000 0x0 0x1000>,
            <0x0 0x31400000 0x0 0x1000>,
            <0x0 0x31401000 0x0 0x1000>;
      interrupts = <GIC_SPI 0 IRQ_TYPE_LEVEL_HIGH>,
              <GIC_SPI 1 IRQ_TYPE_LEVEL_HIGH>;
      #address-cells = <2>;
      #size-cells = <2>;

      memory_controller@32b33000 {
        compatible = "phytium,edac-mc";
        reg = <0x0 0x32b33000 0x0 0x1000>;
        memory-controller = <0>;
      };
    };
```

## Documentation/devicetree/bindings/gpu/phytium,dc.yaml
```yaml
# SPDX-License-Identifier: (GPL-2.0 OR BSD-2-Clause)
%YAML 1.2
---
$id: http://devicetree.org/schemas/gpu/phytium,dc.yaml#
$schema: http://devicetree.org/meta-schemas/core.yaml#

title: Phytium Display Controller

maintainers:
  - Yu Da <yuda2152@phytium.com.cn>

properties:
  compatible:
    enum:
      - phytium,dc

  reg:
    items:
      - description: DC registers

  interrupts:
    maxItems: 1

required:
  - compatible
  - reg
  - interrupts
  - pipe_mask
  - edp_mask

examples:
  - |
    dc@32000000 {
        compatible = "phytium,dc";
        reg = <0x0 0x32000000 0x0 0x8000>;
        interrupts = <GIC_SPI 44 IRQ_TYPE_LEVEL_HIGH>;
        pipe_mask = 0x3;
        edp_mask = 0x0;
    };
```

## Documentation/devicetree/bindings/mtd/phytium,localbus.txt
```
* Phytium localbus controller

The localbus controller(abbr. lbc) in the Phytium Soc now supports eights chip selects,
but can only use one in each use. This lbc supports two kinds of devices, such as async
flash and async sram, sync flash and sync sram are designed to support, but they are banned
as they have not been tested yet.

Required properties:
- compatible : "phytium,localbus".
- reg : first contains the register location and length,
        second contains the memory mapping address and length.
- reg-names : should contains the resource reg names
             - localbus : configuration registers address space
             - lbc_mm : memory mapped address space

Required localbus slave node properties:
- device-type : should contains one of the following:
                - <1>: async flash,
                - <2>: async sram,
                - <3>: sync flash,
                - <4>: sync sram.
- device-time-seq : should contains four elements:
                - [0]: reg CSPR,
                - [1]: reg FTIM0_CS_{NOR/GPCM},
                - [2]: reg FTIM1_CS_{NOR/GPCM},
                - [3]: reg FTIM2_CS_{NOR/GPCM}.
- device-size : should equal to the capacity of slave device.
- bank-width : should contains one of the following:
                - <1> : 1 byte, or 8 bits,
                - <2> : 2 bytes, or 16bits.

Example showing the usage of the localbus controller with one slave device:

lbc: localbus@28003000 {
	compatible = "phytium,localbus";
	#address-cells = <2>;
	#size-cells = <1>;
	reg = <0x00 0x28003000 0x00 0x1000 0x01 0x10000000 0x0 0x10000000>;
	reg-names = "localbus", "lbc_mm";
	status = "disabled";
	norflash@0 {
		device-type = <1>;
		device-time-seq = <0x0003 0x043043 0x3f1f01 0x3fc40f>;
		device-size = <0x10000000>;
		bank-width = <2>;
	};
:};
```

## Documentation/devicetree/bindings/mtd/phytium,localbus.yaml
```yaml
# SPDX-License-Identifier: (GPL-2.0-only OR BSD-2-Clause)
%YAML 1.2
---
$id: http://devicetree.org/schemas/mtd/phytium,localbus.yaml#
$schema: http://devicetree.org/meta-schemas/core.yaml#

title: Phytium Localbus controller

maintainers:
        - Wang Hanmo <wanghanmo@phytium.com.cn>

properties:
        compatible:
                const: phytium,localbus

        reg:
                minitem: 2
                description: first contains the register location and length,
                             second contains the memory mapping address and length.

        reg-names:
                minitem: 2
                description: localbus,configuration registers address space,
                             lbc_mm, memory mapped address space.

patternProperties:
  "^(norflash|sram)@[0-9a-f]+$":
    type: object
    properties:
      device-type:
        description: |
          <1>: async flash
          <2>: async sram
        enum: [1, 2]
      device-time-seq:
        description: |
          [0]: reg CSPR value
          [1]: reg FTIM0_CS_{NOR/GPCM},
          [2]: reg FTIM1_CS_{NOR/GPCM},
          [4]: reg FTIM2_CS_{NOR/GPCM}
        minItems: 4
        maxItems: 4
      device-size:
        enum: [0x4000, 0x8000, 0x10000, 0x20000, 0x40000, 0x80000,
              0x100000, 0x200000, 0x400000, 0x800000, 0x1000000,
              0x2000000, 0x4000000, 0x8000000, 0x10000000]
      bank-width:
        description: |
          <1>: 8 bits
          <2>: 16 bits
        enum: [1, 2]
    required:
      - device-type
      - device-time-seq
      - device-size
      - bank-width
    unevaluatedProperties: false

required:
        - compatible
        - reg
        - reg-names

examples:
        - |
                lbc: localbus@28003000 {
                        compatible = "phytium,localbus";
                        #address-cells = <2>;
                        #size-cells = <1>;
                        reg = <0x00 0x28003000 0x00 0x1000 0x00 0x10000000 0x0 0x10000000>;
                        reg-names = "localbus", "lbc_mm";
                        status = "disabled";
                        norflash@0 {
                                device-type = <1>;
                                device-time-seq = <0x0003 0x043043 0x3f1f01 0x3fc40f>;
                                device-size = <0x10000000>;
                                bank-width = <2>;
                        };
                };

        - |
                lbc: localbus@28007000 {
                        compatible = "phytium,localbus";
                        #address-cells = <2>;
                        #size-cells = <1>;
                        reg = <0x00 0x28007000 0x00 0x1000 0x00 0x10000000 0x0 0x10000000>;
                        reg-names = "localbus", "lbc_mm";
                        status = "disabled";
                        sram@0 {
                                device-type = <2>;
                                device-time-seq = <0x0005 0x1101 0x4045 0x2106>;
                                device-size = <0x200000>;
                                bank-width = <2>;
                        };
                };
```

## Documentation/devicetree/bindings/reset/phytium,reset.yaml
```yaml
# SPDX-License-Identifier: (GPL-2.0-only OR BSD-2-Clause)
%YAML 1.2
---
title: Phytium Reset Controller
======================================

This binding describes a reset-controller for Phytium SoCs.

Required properties:
- compatible:
	Usage: required
	Value type: <string>
	Definition: must be:
		    "phytium,reset"

- reg:
	Usage: required
	Value type: <prop-encoded-array>
	Definition: must specify the base address and size of the register
	            space.

- #reset-cells:
	Usage: required
	Value type: <uint>
	Definition: must be 1; cell entry represents the reset index.

Example:

reset: reset@2807e000 {
	compatible = "phytium,reset";
	reg = <0x0 0x2807e000 0x0 0x10>;
	#reset-cells = <1>;
};

Specifying reset lines connected to IP modules
==============================================

Device nodes that need access to reset lines should
specify them as a reset phandle in their corresponding node.

Example:

i2c0: i2c@28011000 {
	...

	resets = <&reset 0>;

	...
};
```

## Documentation/devicetree/bindings/sound/phytium,i2s.yaml
```yaml
# SPDX-License-Identifier: (GPL-2.0 OR BSD-2-Clause)
* Phytium I2S controller

The I2S bus (Inter-IC sound bus) is a serial link for digital
audio data transfer between devices in the system.

Required properties:


- compatible: should be "phytium,i2s"
- reg: It contains two register region:
       - first is for physical base address and length of I2S controller.
       - second is for physical base address and length of DMA_BDL controller.
- interrupts: should contain the DMA_BDL interrupt.
- clocks: phandle to clock provider with the clock number in the second cell
- dai-name: it will set dai's name used in driver.

Example for pe2204 I2S controller:

i2s@28009000 {
	compatible = "phytium,i2s";
	reg = <0x0 0x28009000 0x0 0x1000>, <0x0 0x28005000 0x0 0x1000>;
	interrupts = <GIC_SPI 77 IRQ_TYPE_LEVEL_HIGH>;
	clocks = <&sysclk_600mhz>;
	dai-name = "phytium-i2s-lsd";
};
```

## Documentation/devicetree/bindings/spi/spi-v2-phytium.txt
```
Phytium SPI-V2 controller

Required properties:
- compatible: should be "phytium,spi-2.0"
- #address-cells: see spi-bus.txt
- #size-cells: see spi-bus.txt
- reg: address and length of the regfile and sharememory
- interrupts: should contain one interrupt
- clocks: spi clock phandle
- num-cs: see spi-bus.txt

Optional properties:
- cs-gpios: see spi-bus.txt

Example:


spi0: spi@27014000 {
	compatible = "phytium,spi-2.0";
	interrupts = <GIC_SPI 18 IRQ_TYPE_LEVEL_HIGH>;
	reg = <0x0 0x27014000 0x0 0x1000 0x0 0x27007000 0x0 0x1000>;
	clocks = <&sysclk_48mhz>;
	num-cs = <4>;
};
```
